## config/west.yml
```yaml
manifest:
  remotes:
    - name: slicemk
      url-base: https://github.com/slicemk
    - name: feerrenrut
      url-base: https://github.com/feerrenrut
  projects:
    - name: zmk
      remote: feerrenrut
      revision: main
      import: app/west.yml
  self:
    path: config
```
